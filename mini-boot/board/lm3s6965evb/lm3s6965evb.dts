/dts-v1/;

/*
 * QEMU lm3s6965evb: what the board has and which SoC blocks it uses.
 */

#include "lm3s6965.dtsi"

/ {
	model = "TI LM3S6965 Evaluation Board (QEMU)";
	compatible = "ti,lm3s6965evb", "ti,lm3s6965";

	/* 8 MHz crystal on the main oscillator */
	clk_xtal: clk-xtal {
		compatible = "fixed-clock";
		#clock-cells = <0>;
		clock-frequency = <8000000>;
	};
};

/* The system clock it runs from the PLL: the chip's maximum */
&sysctl {
	clocks = <&clk_xtal>;
	clock-frequency = <50000000>;
};

/* Console */
&uart0 {
	status = "okay";
	current-speed = <115200>;
};
